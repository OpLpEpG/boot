## Kconfig
```kconfig
mainmenu "modbus Bootloader"

choice PROTOCOL_CHOICE
#	select USE_UARTS11
	bool "select protokol"

config PROTOCOL_MODBUS
	bool "modbus"

config PROTOCOL_1B
	bool "one byte"

config PROTOCOL_2B
	bool "two byte"

config PROTOCOL_CAN
	bool "CAN bas"
	select NOUSE_UARTS
endchoice

config NOUSE_UARTS
	bool
	depends on PROTOCOL_CAN

rsource "system/_LCC/Kconfig"
```

## system/_LCC/Kconfig
```kconfig
comment "c++ moduls (arduino paradigma) _LCC"

config USE_ARDUINO_MAIN
	bool "USE arduino setup() with loop() not main()"

config USE_DEVROOT
	bool "auto init-deinit drivers  use static class DEVROOT" 
	default y

config DEV_COUNT
	depends on USE_DEVROOT
	int "length array drivers"
	default 16
	
rsource "uart.conf"
```
